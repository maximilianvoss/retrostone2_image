## retrostone2-patches/u-boot/retrostone2/A20-Retrostone2_defconfig
```kconfig
CONFIG_ARM=y
CONFIG_ARCH_SUNXI=y
CONFIG_SPL=y
CONFIG_MACH_SUN7I=y
CONFIG_DRAM_CLK=384
CONFIG_MMC0_CD_PIN="PH1"
CONFIG_I2C1_ENABLE=y
CONFIG_SATAPWR="PC3"
CONFIG_AHCI=y
CONFIG_NR_DRAM_BANKS=1
CONFIG_SPL_SPI_SUNXI=y
CONFIG_SPL_I2C=y
CONFIG_DEFAULT_DEVICE_TREE="sun7i-a20-retrostone2"
CONFIG_SCSI_AHCI=y
CONFIG_ETH_DESIGNWARE=y
CONFIG_MII=y
CONFIG_SUN7I_GMAC=y
CONFIG_AXP_ALDO3_VOLT=2800
CONFIG_AXP_ALDO4_VOLT=2800
CONFIG_SCSI=y
CONFIG_USB_EHCI_HCD=y
CONFIG_USB_OHCI_HCD=y
CONFIG_SYS_USB_EVENT_POLL_VIA_INT_QUEUE=y
CONFIG_VIDEO=y
CONFIG_VIDEO_VGA_VIA_LCD=y
CONFIG_VIDEO_VGA_VIA_LCD_FORCE_SYNC_ACTIVE_HIGH=y
CONFIG_VIDEO_LCD_DCLK_PHASE=1
CONFIG_VIDEO_LCD_MODE="x:640,y:480,depth:18,pclk_khz:33000,le:45,ri:209,up:22,lo:22,hs:1,vs:1,sync:3,vmode:0"
CONFIG_VIDEO_LCD_POWER="PH8"
CONFIG_VIDEO_LCD_BL_EN="PH7"
CONFIG_VIDEO_LCD_BL_PWM="PB2"
CONFIG_SYS_I2C_LEGACY=n
CONFIG_ENV_IS_IN_EXT4=y
CONFIG_SYS_I2C_MVTWSI=y
CONFIG_DM_PMIC=y
#CONFIG_SYS_I2C_SLAVE=0x7f
#CONFIG_SYS_I2C_SPEED=400000
CONFIG_SD_BOOT=y
CONFIG_SPI=y
CONFIG_USB_EHCI_HCD=y
CONFIG_USB_OHCI_HCD=y
CONFIG_USB_MUSB_GADGET=y
CONFIG_CMD_MMC=y
CONFIG_SPL_MMC_BOOT=y
CONFIG_SPL_MMC=y
```
